## boards/shields/clog_v4/Kconfig.defconfig
```kconfig
# Copyright (c) 2022 The ZMK Contributors
# SPDX-License-Identifier: MIT

if SHIELD_CLOG_V4_LEFT

config ZMK_KEYBOARD_NAME
    default "Clog V4"
    
config ZMK_SPLIT_ROLE_CENTRAL
    default y

endif

if SHIELD_CLOG_V4

config ZMK_SPLIT
    default y

endif
```

## boards/shields/clog_v4/Kconfig.shield
```kconfig
# Copyright (c) 2022 The ZMK Contributors
# SPDX-License-Identifier: MIT

config SHIELD_CLOG_V4
    bool

config SHIELD_CLOG_V4_LEFT
    def_bool $(shields_list_contains,clog_v4_left)
    select SHIELD_CLOG_V4

config SHIELD_CLOG_V4_RIGHT
    def_bool $(shields_list_contains,clog_v4_right)
    select SHIELD_CLOG_V4
```
